## kernel/Kconfig
```kconfig
# SPDX-License-Identifier: GPL-2.0-only

config SECURITY_PKM
	bool "PKM — Peios Kernel Module"
	depends on SECURITY
	depends on RUST
	depends on 64BIT
	depends on STRICT_DEVMEM
	depends on MODULE_SIG_FORCE
	depends on !SECURITY_SELINUX
	depends on !SECURITY_APPARMOR
	depends on !SECURITY_SMACK
	depends on !SECURITY_TOMOYO
	select CRYPTO_MLDSA
	help
	  PKM is the Peios Kernel Module used for the KACS slow track.
	  The current slow-track tree contains the bounded slow-track
	  scaffold plus the first narrow public token-open surface.
	  Broader syscall, handle, and enforcement behavior is still added
	  deliberately slice by slice rather than carried forward implicitly.

	  KACS must be the sole MAC LSM. Conflicting MAC LSMs (SELinux,
	  AppArmor, SMACK, TOMOYO) are rejected at Kconfig level.
	  Non-MAC LSMs (landlock, lockdown, yama, integrity) are accepted.

	  If unsure, say N.

	  KACS also requires STRICT_DEVMEM and MODULE_SIG_FORCE. These are
	  defense-in-depth prerequisites for PIP: unrestricted /dev/mem and
	  unsigned kernel modules both bypass process-isolation guarantees by
	  entering the kernel trust boundary directly.

config SECURITY_PKM_FIRMWARE_SIG_ENFORCE
	bool "Refuse firmware that does not carry a PeiosTcb PIP signature"
	depends on SECURITY_PKM
	default n
	help
	  KACS verifies the PIP signature (security.peios.sig) of every file
	  the kernel reads as firmware and requires the PeiosTcb tier. With
	  this option the load is refused (-EPERM) when that fails; without
	  it the verdict is logged and traced (kacs:kacs_firmware_load) and
	  the load proceeds. Either way the boot command line can override
	  the choice for one boot with kacs_fwsig=enforce or kacs_fwsig=log.

	  Leave this off until every firmware package in the release is
	  signed; a missed blob under enforcement is a device that silently
	  stops probing. PEI-493.

config SECURITY_PKM_KUNIT
	bool "PKM KUnit scaffold"
	depends on SECURITY_PKM
	depends on KUNIT
	help
	  Build the minimal PKM-owned KUnit scaffold.

	  This option is only for kernel-resident glue that Cargo tests cannot
	  exercise. Pure `kacs-core` semantics remain owned by the Rust
	  userspace/Cargo test suite.

	  If unsure, say N.
```

## pnp/Kconfig
```kconfig
# SPDX-License-Identifier: GPL-2.0-only

config PEIOS_PNP
	bool "PNP — Peios Network Policy packet engine"
	depends on SECURITY_PKM
	depends on NETFILTER
	depends on NETFILTER_INGRESS
	depends on NETFILTER_EGRESS
	depends on NF_CONNTRACK=y
	help
	  The Peios Network Policy packet engine: the packet and RawPacket
	  rules layers, standing at the netfilter device seats (ingress,
	  egress) and the IP hooks. Policy is a forest of rule trees read
	  from the registry; semantics live in the pnp-core Rust crate,
	  staged into security/pkm and reached over the C ABI.

	  This replaces nf_tables and the xtables family on Peios — the
	  policy frontends are configured out, the netfilter hook framework
	  and conntrack machinery stay. Until the first policy generation
	  ingests, the engine is loudly permissive (generation 0).

	  conntrack must be built-in (=y): PNP itself is built-in and reads
	  flow facts on the packet path.

	  If unsure, say N.

config PEIOS_PNP_KUNIT
	bool "PNP KUnit tests"
	depends on PEIOS_PNP && KUNIT
	default SECURITY_PKM_KUNIT
	help
	  In-kernel tests for PNP's kernel-resident glue: the seat snapshot
	  builder and the dispatch predicate. Pure rules-engine semantics
	  remain owned by the pnp-core cargo suite.
```

## stratafs/Kconfig
```kconfig
# SPDX-License-Identifier: GPL-2.0-only

config STRATAFS_FS
	bool "StrataFS layered directory filesystem"
	depends on SECURITY_PKM
	select FS_STACK
	help
	  StrataFS presents an ordered set of independently managed directories
	  as one live merged tree.  It is the Peios Linux-compatibility filesystem
	  specified by PSD-011.

	  If unsure, say N.

config STRATAFS_FS_TEST_HOOKS
	bool "StrataFS test rendezvous and fail points"
	depends on STRATAFS_FS && SECURITYFS
	help
	  Compile in the securityfs hooks conformance tests use to hold a
	  copy-up open mid-flight or fail an internal step of one syscall
	  — windows no arrangement of real filesystems can produce.
	  (securityfs, not debugfs: kernel lockdown in integrity mode
	  refuses debugfs opens, and this kernel forces that mode.)

	  The hooks are doubly gated: even when built, nothing registers
	  and every hook site reduces to reading one never-true bool
	  unless the kernel is booted with stratafs.test_hooks=1. Only a
	  caller that can reach a mounted securityfs can then arm them.

	  If unsure, say N.

config STRATAFS_KUNIT_TEST
	bool "StrataFS KUnit tests"
	depends on STRATAFS_FS && KUNIT
	default SECURITY_PKM_KUNIT
	help
	  Exercise StrataFS mount parsing and bounded policy glue in-kernel.
```
