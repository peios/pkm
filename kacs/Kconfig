## kacs/Kconfig
```kconfig
# SPDX-License-Identifier: GPL-2.0-only

config SECURITY_KACS
	bool "KACS — Kernel-based Access Control System"
	depends on SECURITY
	depends on RUST
	default n
	help
	  KACS is a Linux Security Module that implements the Windows NT
	  security model (tokens, Security Descriptors, AccessCheck) in
	  the Linux kernel. It is the security foundation of Peios.

	  If unsure, say N.
```
